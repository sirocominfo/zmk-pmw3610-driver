## Kconfig
```kconfig
# Sensor data simulator
#
# Copyright (c) 2019 Nordic Semiconductor
#
# SPDX-License-Identifier: LicenseRef-Nordic-5-Clause
#

menuconfig PMW3610
    bool "PMW3610 mouse optical sensor"
  select SPI
    help
      Enable PMW3610 mouse optical sensor.

if PMW3610

config PMW3610_SMART_ALGORITHM
  bool "Enable an algorithm of PMW3610 to enhance surface coverage"
  default y
  help
    Enable the integration of the smart algorithm as the datasheet implementation.
    The algorithm is used to extend the tracking acrocss a wider range of surfaces
    such as graniles and tiles.

config PMW3610_CPI
    int "PMW3610's default CPI"
    default 800
    range 200 3200
    help
      Default CPI value, with 200 step

config PMW3610_CPI_DIVIDOR
    int "PMW3610's default CPI dividor"
    default 1
    range 1 100
    help
      Default CPI dividor value.

config PMW3610_SNIPE_CPI
    int "PMW3610's CPI in snipe mode"
    default 200
    range 200 3200
    help
      Snipe CPI value, with 200 step

config PMW3610_SNIPE_CPI_DIVIDOR
    int "PMW3610's CPI dividor in snipe mode"
    default 1
    range 1 100
    help
      Snipe CPI dividor value.

config PMW3610_SCROLL_TICK
    int "PMW3610's required ticks to produce a scroll report"
    default 20
    help
      Scroll tick value.

choice
    prompt "Select PMW3610's polling rate"
    default PMW3610_POLLING_RATE_250

config PMW3610_POLLING_RATE_250
    bool "250 Hz"

config PMW3610_POLLING_RATE_125
    bool "125 Hz"

config PMW3610_POLLING_RATE_125_SW
    bool "125 Hz with software implementation"

endchoice

config PMW3610_FORCE_AWAKE
    bool "PMW3610 forced awake mode"
    help
      This setting forces the sensor to always be in the RUN state.

config PMW3610_RUN_DOWNSHIFT_TIME_MS
    int "PMW3610's default RUN mode downshift time"
    default 128
    range 13 3264
    help
      Default RUN mode downshift down time in milliseconds.
      Time after which sensor goes from RUN to REST1 mode.

config PMW3610_REST1_SAMPLE_TIME_MS
    int "PMW3610's sample time in REST1 stage"
    default 40
    range 10 2550
    help
      Default REST1 mode sample period in millisecond

config PMW3610_REST1_DOWNSHIFT_TIME_MS
    int "PMW3610's default REST1 mode downshift time"
    default 9600
    help
      Default REST1 mode downshift down time in milliseconds.
      Time after which sensor goes from REST1 to REST2 mode.

config PMW3610_REST2_SAMPLE_TIME_MS
    int "PMW3610's sample time in REST2 stage"
    default 0
    range 0 2550
    help
      Default REST2 mode sample period in millisecond.
      Minimum value is 10.
      No optimal value provided by datasheet.

config PMW3610_REST2_DOWNSHIFT_TIME_MS
    int "PMW3610's default REST2 mode downshift time"
    default 0
    help
      Default REST2 mode downshift down time in milliseconds.
      Time after which sensor goes from REST2 to REST3 mode.
      No optimal value provided by datasheet.

config PMW3610_REST3_SAMPLE_TIME_MS
    int "PMW3610's sample time in REST3 stage"
    default 0
    range 0 2550
    help
      Default REST2 mode sample period in millisecond.
      Minimum value is 10.
      No optimal value provided by datasheet.

choice
    prompt "Select PMW3610 sensor orientation"
    default PMW3610_ORIENTATION_0

config PMW3610_ORIENTATION_0
    bool "PMW3610 not rotated"

config PMW3610_ORIENTATION_90
    bool "PMW3610 rotated 90 deg clockwise"

config PMW3610_ORIENTATION_180
    bool "PMW3610 rotated 180 deg clockwise"

config PMW3610_ORIENTATION_270
    bool "PMW3610 rotated 270 deg clockwise"

endchoice

config PMW3610_INVERT_X
  bool "Invert the X axis of PMW3610 sensor"

config PMW3610_INVERT_Y
  bool "Invert the Y axis of PMW3610 sensor"

config PMW3610_INVERT_SCROLL_X
  bool "Invert the X axis of the scroll"
  default PMW3610_INVERT_X

config PMW3610_INVERT_SCROLL_Y
  bool "Invert the Y axis of the scroll"
  default PMW3610_INVERT_Y

config PMW3610_AUTOMOUSE_TIMEOUT_MS
  int "Amount of milliseconds the mouse layer will be active after using the trackball"
  default 400

module = PMW3610
module-str = PMW3610
source "${ZEPHYR_BASE}/subsys/logging/Kconfig.template.log_config"

endif #PMW3610

menuconfig KIMI_QUAD_ENCODER
    bool "Kimi custom quadrature rotary encoder driver"
    default y
    depends on DT_HAS_KIMI_QUAD_ENCODER_ENABLED
    depends on GPIO
    help
      ZMK本体の標準EC11ドライバ(alps,ec11)は、A/Bどちらかの変化を検知すると
      両方の割り込みを止め、読み終わるまで再開しない。ハーフステップ式
      エンコーダー(例: ALPS EC10E1220501、24ディテント/12パルス)では、
      片側のディテント遷移で2本の接点がごく短い間隔で切り替わるため、
      その禁止窓の中にもう一方の変化が収まり丸ごと失われる
      （実機で確認、専用スレッド化でも改善せず）。
      このドライバは変化検知時にピンを読み演算するところまでを割り込み
      コンテキストで完結させ、割り込み自体は起動後一切無効化しない。

if KIMI_QUAD_ENCODER

config KIMI_QUAD_ENCODER_THREAD_STACK_SIZE
    int "Thread stack size"
    default 768
    help
      ZMKへの報告(BLE通知まで到達しうる)だけを行う専用スレッドのスタックサイズ。

config KIMI_QUAD_ENCODER_THREAD_PRIORITY
    int "Thread priority (cooperative)"
    default 0
    help
      協調的優先度。数値が小さいほど優先度が高い。

module = KIMI_QUAD_ENCODER
module-str = KIMI_QUAD_ENCODER
source "${ZEPHYR_BASE}/subsys/logging/Kconfig.template.log_config"

endif # KIMI_QUAD_ENCODER
```

## dts/bindings/kimi,quad-encoder.yml
```yaml
description: |
  Kimi 独自のクアドラチャ・ロータリーエンコーダー・デコーダー。

  ZMK本体の標準ドライバ(alps,ec11)は、A相・B相どちらかの変化を検知すると
  「両方の割り込みを止めてから、状態を読んで報告し終えるまで再開しない」
  という作りになっている。ALPS EC10E1220501のような「1回転24ディテント/
  12パルス」型（＝2ディテントで1クアドラチャ周期）のハーフステップ式
  エンコーダーでは、片側のディテント遷移で2本の接点がごく短い間隔で
  切り替わるため、その割り込み禁止の窓の中にもう一方の変化が収まってしまい
  丸ごと失われる（実機で確認、専用スレッド化でも改善せず）。

  このドライバは、変化を検知したその場（割り込みコンテキスト）でピンを読み
  演算するところまでを完結させ、割り込み自体は起動時に一度有効化したら
  以後一切無効化しない。時間のかかる「ZMKへ報告する」処理だけを専用スレッドへ
  逃がす。これにより上記の取りこぼしが原理的に起きなくなる。

compatible: "kimi,quad-encoder"

properties:
  a-gpios:
    type: phandle-array
    required: true
    description: A相ピン
  b-gpios:
    type: phandle-array
    required: true
    description: B相ピン
  steps:
    type: int
    default: 48
    description: |
      1回転あたりのクアドラチャ・エッジ数（＝PPR×4）。
      alps,ec11 の steps プロパティと同じ意味・同じ換算。
  dummy:
    type: boolean
    description: |
      true にすると割り込みを一切張らない。split構成でcentral側に置く
      「実際には配線されていないダミーノード」用（zmk,keymap-sensors の
      ローカル登録要件とKconfig依存を満たすためだけに存在させる場合）。
      a-gpios/b-gpios が完全に浮いた未接続ピンだと、割り込みを常時有効化する
      このドライバの設計ではノイズを拾って連続発火しかねないため、
      ダミー用途では最初から割り込みを張らないほうが安全。
```
